## arch/arm/mach-zynq/Kconfig
```kconfig
# SPDX-License-Identifier: GPL-2.0
config ARCH_ZYNQ
	bool "Xilinx Zynq ARM Cortex A9 Platform"
	depends on ARCH_MULTI_V7
	select ARCH_HAS_RESET_CONTROLLER
	select ARCH_SUPPORTS_BIG_ENDIAN
	select ARM_AMBA
	select ARM_GIC
	select ARM_GLOBAL_TIMER if !CPU_FREQ
	select CADENCE_TTC_TIMER
	select HAVE_ARM_SCU if SMP
	select HAVE_ARM_TWD if SMP
	select ICST
	select MFD_SYSCON
	select PINCTRL
	select PINCTRL_ZYNQ
	select SOC_BUS
	help
	  Support for Xilinx Zynq ARM Cortex A9 Platform

if ARCH_ZYNQ

menu "Xilinx Specific Options"

config XILINX_PREFETCH
	bool "Cache Prefetch"
	default y
	help
	  This option turns on L1 & L2 cache prefetching to get the best performance
	  in many cases. This may not always be the best performance depending on
	  the usage.

config NAI_XILINX_QSPI_RESET_WR
	bool "Reset QPSI before software reset"
	help
	  This option enables the NAI workround for a bootrom error after software
	  reset with 32MB QSPI flash.

config NAI_XILINX_QSPI_RESET_WR_GPIO_7
	bool "Use GPIO 7 to reset QSPI chip"
	help
	  select GPIO 7 to reset QSPI chip

config NAI_XILINX_QSPI_RESET_WR_GPIO
	int
	default 7 if NAI_XILINX_QSPI_RESET_WR_GPIO_7
	default 9

endmenu

endif
```

## drivers/misc/nai-ep-shrm/Kconfig
```kconfig
menu "NAI EP SHRM Support"
 config NAI_EP_SHRM
	tristate "NAI end-point share memory driver"
        help
          This ia NAI board specific device driver.
          This device driver supports read/write to share block of congtiguous memory
          between NAI SBC via PCIe/VME/cPCI
endmenu
```

## drivers/misc/nai-generic-i2c/Kconfig
```kconfig
menu "NAI GENERIC I2C"

config NAI_GENERIC_SMBUS
	tristate "NAI devices Over SMBUS"
	depends on I2C
        default y
	help
	  This option enables generic i2c devices Over SMBUS

config NAI_GENERIC_I2C
	tristate "NAI devices Over I2C"
	depends on NAI_GENERIC_SMBUS
	help
	  This option enables generic i2c devices Over I2C
endmenu
```

## drivers/misc/nai-pci-device/Kconfig
```kconfig
menu "NAI PCI Device support"

config NAI_PCI_DEVICE
	tristate "NAI PCI Device"
	select CONFIG_PCI
	help
	  This option to enable NAI PCI Device Support.

	  If unsure, say N.

endmenu
```

## drivers/vme/devices/Kconfig
```kconfig
comment "VME Device Drivers"

config NAI_VME_USER
	tristate "NAI VME user space access driver"
	help
	  If you say Y here you want to be able to access VME windows.
```
